## boards/shields/goblit/Kconfig.shield
```kconfig
config SHIELD_GOBLIT_LEFT
    def_bool $(shields_list_contains,goblit_left)

config SHIELD_GOBLIT_RIGHT
    def_bool $(shields_list_contains,goblit_right)

config SHIELD_GOBLIT_DONGLE
	def_bool $(shields_list_contains,goblit_dongle)
```

## config/boards/shields/goblit/Kconfig.defconfig
```kconfig
if SHIELD_GOBLIT_LEFT

config ZMK_KEYBOARD_NAME
    default "goblit"

config ZMK_SPLIT_ROLE_CENTRAL
    default y

endif

if SHIELD_GOBLIT_LEFT || SHIELD_GOBLIT_RIGHT

config ZMK_SPLIT
    default y

endif
```

## config/boards/shields/goblit/Kconfig.shield
```kconfig
# Copyright (c) 2020 Pete Johanson
# SPDX-License-Identifier: MIT

config SHIELD_GOBLIT_LEFT
    def_bool $(shields_list_contains,goblit_left)

config SHIELD_GOBLIT_RIGHT
    def_bool $(shields_list_contains,goblit_right)

#config SHIELD_DRIFT_DONGLE
#	def_bool $(shields_list_contains,drift_dongle)
```

## config/west.yml
```yaml
manifest:
  remotes:
    - name: zmkfirmware
      url-base: https://github.com/zmkfirmware
    - name: badjeff
      url-base: https://github.com/badjeff
    - name: nuovotaka
      url-base: https://github.com/nuovotaka
    - name: timception
      url-base: https://github.com/timception
  projects:
    - name: zmk
      remote: zmkfirmware
      revision: main
      import: app/west.yml
    - name: zmk-pmw3610-driver
      remote: badjeff
      revision: main
    - name: zmk-pointing-acceleration-alpha
      remote: nuovotaka
      revision: main
    - name: zmk-behavior-key-press-lip
      remote: timception
      revision: main
  self:
    path: config
```
